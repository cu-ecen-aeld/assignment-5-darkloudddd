## base_external/Config.in
```kconfig
#
#source "base_external/package/aesd-assignments/Config.in"
config BR2_PACKAGE_AESD_ASSIGNMENTS
    bool "aesd assignments (finder + writer)"
    help
      This package builds the AESD assignment programs (writer + finder)
      and installs them into /usr/bin (finder → uses /etc/finder-app/conf).
```

## base_external/configs/aesd_qemu_defconfig
```kconfig
# Architecture
BR2_aarch64=y
BR2_cortex_a53=y

# System
BR2_SYSTEM_DHCP="eth0"

# Filesystem
BR2_TARGET_ROOTFS_EXT4=y
BR2_TARGET_ROOTFS_EXT4_4=y

# Build our aesd-assignments package
BR2_PACKAGE_AESD_ASSIGNMENTS=y

# Image
BR2_ROOTFS_POST_IMAGE_SCRIPT="board/qemu/post-image.sh"
BR2_ROOTFS_POST_SCRIPT_ARGS="$(BR2_DEFCONFIG)"

# Linux headers same as kernel
BR2_PACKAGE_HOST_LINUX_HEADERS_CUSTOM_6_1=y

# Linux kernel
BR2_LINUX_KERNEL=y
# Use our custom AArch64 virt config
BR2_LINUX_KERNEL_CUSTOM_CONFIG_FILE="board/qemu/aarch64-virt/linux.config"
BR2_LINUX_KERNEL_USE_CUSTOM_CONFIG=y

# host-qemu for gitlab testing
BR2_PACKAGE_HOST_QEMU=y
BR2_PACKAGE_HOST_QEMU_SYSTEM_MODE=y
```

## base_external/package/aesd-assignments/Config.in
```kconfig
config BR2_PACKAGE_AESD_ASSIGNMENTS
    bool "aesd-assignments"
    help
      Builds and installs the finder, writer and tester scripts
      from your Assignment 3 repo into the target filesystem.
```
